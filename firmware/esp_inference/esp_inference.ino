/*
  ESP32-S3 on-device hierarchical inference
  ─────────────────────────────────────────
  Stage A  –  Mathematics (no training required)
    Moving Variance Score (MVS) + Narrowband Variance Indicator (NBVI)
    Inspired by the ESPectre project: https://github.com/francescopace/espectre

  Stage B  –  LogisticRegression (walking vs running)
    Weights are compiled in from model_b_weights.h which is generated by
      python -m custom_espectre.export_model_b

  Hardware
    - ESP32-S3 (any board, 2.4 GHz Wi-Fi)
    - Tenda router on the same network; optional UDP traffic from a laptop

  Serial output (921600 baud)
    One JSON line per window, e.g.:
      {"window":1,"stage_a":"idle","mvs":0.000041,"nbvi":1.23}
      {"window":2,"stage_a":"motion","stage_b":"walking","mvs":0.012,"nbvi":5.4}

  Calibration
    During CALIBRATION_WINDOWS at startup the device collects idle
    windows to build the NBVI baseline and to auto-tune the MVS
    threshold (3× the idle level).  Keep the room empty for the first
    ~15 seconds after boot.

  Build
    Arduino IDE with "esp32 by Espressif Systems" board package.
    Place model_b_weights.h in the same folder as this .ino, or
    comment out ENABLE_STAGE_B if you have not trained Stage-B yet.
*/

#include <Arduino.h>
#include <WiFi.h>
#include "esp_wifi.h"

// ─────────────────────────────────────────────────────────────────
// USER CONFIGURATION – edit before uploading
// ─────────────────────────────────────────────────────────────────
const char *WIFI_SSID     = "ESPECTRE_LAB";
const char *WIFI_PASSWORD = "12345678";

// Set to 1 once you have run export_model_b.py and placed the header
// in this directory.  Set to 0 to skip Stage-B (Stage-A only).
#define ENABLE_STAGE_B 0

#if ENABLE_STAGE_B
#include "model_b_weights.h"
#endif

// ─────────────────────────────────────────────────────────────────
// CONSTANTS
// ─────────────────────────────────────────────────────────────────
constexpr size_t  MAX_SUBCARRIERS      = 128;
constexpr size_t  WINDOW_SIZE          = 100;   // packets per window
constexpr size_t  QUEUE_LENGTH         = 4;     // packet ring buffer
constexpr size_t  CALIBRATION_WINDOWS  = 10;    // idle windows at boot
constexpr size_t  MVS_WIN              = 50;    // moving-var sub-window
constexpr float   MVS_DEFAULT          = 0.01f;
constexpr float   NBVI_THRESHOLD       = 2.5f;
constexpr float   CALIBRATION_FACTOR   = 3.0f;  // mvs_threshold = idle * 3

// ─────────────────────────────────────────────────────────────────
// CSI PACKET STRUCTURE
// ─────────────────────────────────────────────────────────────────
struct CsiPacket {
    float    amplitudes[MAX_SUBCARRIERS];
    float    phases[MAX_SUBCARRIERS];
    uint16_t subcarrierCount;
    uint16_t rawLength;
    uint32_t sequence;
};

// ─────────────────────────────────────────────────────────────────
// RING BUFFER (same design as original sketch)
// ─────────────────────────────────────────────────────────────────
CsiPacket        packetQueue[QUEUE_LENGTH];
volatile size_t  queueHead      = 0;
volatile size_t  queueTail      = 0;
volatile uint32_t packetSequence = 0;
portMUX_TYPE     queueMux       = portMUX_INITIALIZER_UNLOCKED;

// ─────────────────────────────────────────────────────────────────
// WINDOW ACCUMULATOR
// ─────────────────────────────────────────────────────────────────
// One window: WINDOW_SIZE packets normalised to maxSubcarriers columns.
// Stored as a flat float array [packet][subcarrier].
static size_t maxSubcarriers   = 0;
static size_t packetCount      = 0;
static float  winAmp[WINDOW_SIZE][MAX_SUBCARRIERS];  // amplitudes buffer

// ─────────────────────────────────────────────────────────────────
// CALIBRATION STATE
// ─────────────────────────────────────────────────────────────────
static bool   calibrated           = false;
static float  quietVariances[MAX_SUBCARRIERS];  // per-subcarrier baseline
static float  mvsThreshold         = MVS_DEFAULT;
static size_t calibWindowsCollected = 0;
// Accumulate sums for calibration (mean per-subcarrier variance).
static double calibVarSum[MAX_SUBCARRIERS];
static double calibMvsSum          = 0.0;

// ─────────────────────────────────────────────────────────────────
// WINDOW COUNTER
// ─────────────────────────────────────────────────────────────────
static uint32_t windowIndex = 0;

// =================================================================
// Wi-Fi and CSI setup (same pattern as original sketch)
// =================================================================

void csiCallback(void *context, wifi_csi_info_t *info)
{
    if (info == nullptr || info->buf == nullptr || info->len < 2)
        return;

    portENTER_CRITICAL_ISR(&queueMux);
    size_t nextHead = (queueHead + 1) % QUEUE_LENGTH;
    if (nextHead == queueTail)
        queueTail = (queueTail + 1) % QUEUE_LENGTH;  // drop oldest

    CsiPacket &pkt = packetQueue[queueHead];
    size_t available = static_cast<size_t>(info->len) / 2;
    pkt.subcarrierCount = (uint16_t)min(available, MAX_SUBCARRIERS);
    pkt.rawLength       = (uint16_t)info->len;
    pkt.sequence        = ++packetSequence;

    for (size_t i = 0; i < pkt.subcarrierCount; ++i) {
        int imag = static_cast<int8_t>(info->buf[i * 2]);
        int real = static_cast<int8_t>(info->buf[i * 2 + 1]);
        pkt.amplitudes[i] = sqrtf((float)(real * real + imag * imag));
        pkt.phases[i]     = atan2f((float)imag, (float)real);
    }
    queueHead = nextHead;
    portEXIT_CRITICAL_ISR(&queueMux);
}

bool popPacket(CsiPacket &pkt)
{
    bool ok = false;
    portENTER_CRITICAL(&queueMux);
    if (queueTail != queueHead) {
        pkt      = packetQueue[queueTail];
        queueTail = (queueTail + 1) % QUEUE_LENGTH;
        ok = true;
    }
    portEXIT_CRITICAL(&queueMux);
    return ok;
}

void connectWiFi()
{
    WiFi.mode(WIFI_STA);
    WiFi.setSleep(false);
    WiFi.begin(WIFI_SSID, WIFI_PASSWORD);
    Serial.printf("Connecting to %s", WIFI_SSID);
    while (WiFi.status() != WL_CONNECTED) {
        delay(500);
        Serial.print(".");
    }
    Serial.println();
    Serial.printf("Wi-Fi connected; IP: %s\n", WiFi.localIP().toString().c_str());
}

void enableCsi()
{
    wifi_csi_config_t cfg = {};
    cfg.lltf_en           = true;
    cfg.htltf_en          = true;
    cfg.stbc_htltf2_en    = true;
    cfg.ltf_merge_en      = true;
    cfg.channel_filter_en = false;
    cfg.manu_scale        = false;
    cfg.shift             = false;
    esp_wifi_set_csi_config(&cfg);
    esp_wifi_set_csi_rx_cb(csiCallback, nullptr);
    esp_wifi_set_csi(true);
    Serial.println("CSI enabled.");
}

// =================================================================
// MATHEMATICS — Stage-A detector
// =================================================================

/** Per-packet mean amplitude across subcarriers. */
static inline float amplitudeEnvelope(size_t packetIdx, size_t numSub)
{
    float sum = 0.0f;
    for (size_t c = 0; c < numSub; ++c)
        sum += winAmp[packetIdx][c];
    return sum / (float)numSub;
}

/**
 * Moving Variance Score (MVS).
 * Mean variance of sliding sub-windows of length mvs_win over the
 * amplitude envelope.
 */
float computeMVS(const float envelope[], size_t n, size_t mvs_win)
{
    if (n < mvs_win) {
        // Fall back: variance of the whole envelope.
        float mean = 0.0f;
        for (size_t i = 0; i < n; ++i) mean += envelope[i];
        mean /= (float)n;
        float var = 0.0f;
        for (size_t i = 0; i < n; ++i) var += (envelope[i] - mean) * (envelope[i] - mean);
        return var / (float)n;
    }

    double varSum = 0.0;
    size_t count  = 0;
    for (size_t start = 0; start + mvs_win <= n; ++start) {
        float m = 0.0f;
        for (size_t k = 0; k < mvs_win; ++k) m += envelope[start + k];
        m /= (float)mvs_win;
        float v = 0.0f;
        for (size_t k = 0; k < mvs_win; ++k)
            v += (envelope[start + k] - m) * (envelope[start + k] - m);
        varSum += v / (float)mvs_win;
        ++count;
    }
    return (count > 0) ? (float)(varSum / count) : 0.0f;
}

/**
 * Narrowband Variance Indicator (NBVI).
 * Mean of per-subcarrier temporal variances, normalised by the quiet
 * baseline when available.
 */
float computeNBVI(size_t n, size_t numSub, const float *quietVar, bool hasBaseline)
{
    double total = 0.0;
    for (size_t c = 0; c < numSub; ++c) {
        float mean = 0.0f;
        for (size_t t = 0; t < n; ++t) mean += winAmp[t][c];
        mean /= (float)n;
        float var = 0.0f;
        for (size_t t = 0; t < n; ++t)
            var += (winAmp[t][c] - mean) * (winAmp[t][c] - mean);
        var /= (float)n;

        if (hasBaseline) {
            float denom = quietVar[c] < 1e-8f ? 1e-8f : quietVar[c];
            total += var / denom;
        } else {
            total += var;
        }
    }
    return (float)(total / numSub);
}

// =================================================================
// STAGE-B FEATURE EXTRACTION (13 features)
// Mirrors features.py / extract_activity_features()
// =================================================================

#if ENABLE_STAGE_B

/** Sample rate assumed for frequency calculations (Hz). */
constexpr float SAMPLE_RATE_HZ = 61.0f;

/** Amplitude envelope stored during window collection. */
static float envelope[WINDOW_SIZE];

static float featureAmpVariance(const float env[], size_t n)
{
    float mean = 0.0f;
    for (size_t i = 0; i < n; ++i) mean += env[i];
    mean /= n;
    if (fabsf(mean) < 1e-8f) return 0.0f;
    float var = 0.0f;
    for (size_t i = 0; i < n; ++i) var += (env[i] - mean) * (env[i] - mean);
    return (var / n) / (mean * mean);
}

static float featureRateOfChange(const float env[], size_t n)
{
    float mean = 0.0f;
    for (size_t i = 0; i < n; ++i) mean += env[i];
    mean /= n;
    if (fabsf(mean) < 1e-8f) return 0.0f;
    float sum = 0.0f;
    for (size_t i = 1; i < n; ++i) sum += fabsf(env[i] - env[i - 1]);
    return (sum / (n - 1)) / mean;
}

static float featureMaxSlope(const float env[], size_t n)
{
    float mean = 0.0f;
    for (size_t i = 0; i < n; ++i) mean += env[i];
    mean /= n;
    if (fabsf(mean) < 1e-8f) return 0.0f;
    float mx = 0.0f;
    for (size_t i = 1; i < n; ++i) {
        float d = fabsf(env[i] - env[i - 1]);
        if (d > mx) mx = d;
    }
    return mx / mean;
}

static float featureZeroCrossingRate(const float env[], size_t n)
{
    float mean = 0.0f;
    for (size_t i = 0; i < n; ++i) mean += env[i];
    mean /= n;
    int crossings = 0;
    for (size_t i = 1; i < n; ++i) {
        bool was_neg = (env[i - 1] - mean) < 0.0f;
        bool is_neg  = (env[i]     - mean) < 0.0f;
        if (was_neg != is_neg) ++crossings;
    }
    return (float)crossings / (float)(n - 1);
}

/**
 * Simple DFT peak in [0.5, 10] Hz band.
 * Uses 128-point zero-padded sum (no FFT library needed).
 * Returns dominant frequency in Hz, or 0 if variance is too low.
 */
static float featureDominantFreq(const float env[], size_t n)
{
    if (featureAmpVariance(env, n) < 0.01f) return 0.0f;

    float mean = 0.0f;
    for (size_t i = 0; i < n; ++i) mean += env[i];
    mean /= n;

    constexpr int N = 128;
    float bestPow = -1.0f;
    float bestFreq = 0.0f;

    for (int k = 1; k < N / 2 + 1; ++k) {
        float freq = (float)k * SAMPLE_RATE_HZ / (float)N;
        if (freq < 0.5f || freq > 10.0f) continue;

        float re = 0.0f, im = 0.0f;
        for (size_t t = 0; t < n && t < (size_t)N; ++t) {
            float angle = -2.0f * (float)M_PI * k * t / (float)N;
            re += (env[t] - mean) * cosf(angle);
            im += (env[t] - mean) * sinf(angle);
        }
        float pow = re * re + im * im;
        if (pow > bestPow) { bestPow = pow; bestFreq = freq; }
    }
    return bestFreq;
}

/**
 * Spectral energy ratio: energy in [0.5, 4] Hz / total energy.
 */
static float featureSpectralEnergyRatio(const float env[], size_t n)
{
    if (featureAmpVariance(env, n) < 0.01f) return 0.0f;

    float mean = 0.0f;
    for (size_t i = 0; i < n; ++i) mean += env[i];
    mean /= n;

    constexpr int N = 128;
    float totalE = 0.0f, motionE = 0.0f;

    for (int k = 1; k < N / 2 + 1; ++k) {
        float freq = (float)k * SAMPLE_RATE_HZ / (float)N;
        float re = 0.0f, im = 0.0f;
        for (size_t t = 0; t < n && t < (size_t)N; ++t) {
            float angle = -2.0f * (float)M_PI * k * t / (float)N;
            re += (env[t] - mean) * cosf(angle);
            im += (env[t] - mean) * sinf(angle);
        }
        float e = re * re + im * im;
        totalE += e;
        if (freq >= 0.5f && freq <= 4.0f) motionE += e;
    }
    return (totalE < 1e-12f) ? 0.0f : motionE / totalE;
}

static float featurePhaseSpread(size_t n, size_t numSub)
{
    if (numSub < 2) return 0.0f;
    // Mean std of inter-subcarrier phase differences across time.
    // winPhase not stored, so use amplitude diffs as proxy.
    // (For a more accurate impl, store phases too — see below.)
    return 0.0f;  // placeholder without phase buffer
}

static float featureMeanSubVar(size_t n, size_t numSub)
{
    float total = 0.0f;
    for (size_t c = 0; c < numSub; ++c) {
        float mean = 0.0f;
        for (size_t t = 0; t < n; ++t) mean += winAmp[t][c];
        mean /= n;
        float var = 0.0f;
        for (size_t t = 0; t < n; ++t) var += (winAmp[t][c] - mean) * (winAmp[t][c] - mean);
        total += var / n;
    }
    return total / numSub;
}

static float featureMeanSubStd(size_t n, size_t numSub)
{
    return sqrtf(featureMeanSubVar(n, numSub));
}

static float featureMeanSubMaxSlope(size_t n, size_t numSub)
{
    float total = 0.0f;
    for (size_t c = 0; c < numSub; ++c) {
        float mx = 0.0f;
        for (size_t t = 1; t < n; ++t) {
            float d = fabsf(winAmp[t][c] - winAmp[t - 1][c]);
            if (d > mx) mx = d;
        }
        total += mx;
    }
    return total / numSub;
}

static float featureMeanTemporalRange(size_t n, size_t numSub)
{
    float total = 0.0f;
    for (size_t c = 0; c < numSub; ++c) {
        float mn = winAmp[0][c], mx = winAmp[0][c];
        for (size_t t = 1; t < n; ++t) {
            if (winAmp[t][c] < mn) mn = winAmp[t][c];
            if (winAmp[t][c] > mx) mx = winAmp[t][c];
        }
        total += mx - mn;
    }
    return total / numSub;
}

static float featureSubcarrierMeanStd(size_t n, size_t numSub)
{
    // Std of per-subcarrier mean amplitudes.
    float means[MAX_SUBCARRIERS];
    float grandMean = 0.0f;
    for (size_t c = 0; c < numSub; ++c) {
        float m = 0.0f;
        for (size_t t = 0; t < n; ++t) m += winAmp[t][c];
        means[c] = m / n;
        grandMean += means[c];
    }
    grandMean /= numSub;
    float var = 0.0f;
    for (size_t c = 0; c < numSub; ++c) var += (means[c] - grandMean) * (means[c] - grandMean);
    return sqrtf(var / numSub);
}

static float featureSubcarrierMeanRange(size_t n, size_t numSub)
{
    float mn = 1e30f, mx = -1e30f;
    for (size_t c = 0; c < numSub; ++c) {
        float m = 0.0f;
        for (size_t t = 0; t < n; ++t) m += winAmp[t][c];
        m /= n;
        if (m < mn) mn = m;
        if (m > mx) mx = m;
    }
    return mx - mn;
}

/** Build the 13-element Stage-B feature vector. */
static void extractFeatureVectorB(float feat[MODEL_B_FEATURE_COUNT],
                                   size_t n, size_t numSub)
{
    // Recompute envelope.
    for (size_t t = 0; t < n; ++t) {
        float s = 0.0f;
        for (size_t c = 0; c < numSub; ++c) s += winAmp[t][c];
        envelope[t] = s / numSub;
    }

    feat[0]  = featureDominantFreq(envelope, n);
    feat[1]  = featureSpectralEnergyRatio(envelope, n);
    feat[2]  = featureAmpVariance(envelope, n);
    feat[3]  = featureRateOfChange(envelope, n);
    feat[4]  = featureZeroCrossingRate(envelope, n);
    feat[5]  = featurePhaseSpread(n, numSub);   // 0 unless phase buf added
    feat[6]  = featureMaxSlope(envelope, n);
    feat[7]  = featureMeanSubVar(n, numSub);
    feat[8]  = featureMeanSubStd(n, numSub);
    feat[9]  = featureMeanSubMaxSlope(n, numSub);
    feat[10] = featureMeanTemporalRange(n, numSub);
    feat[11] = featureSubcarrierMeanStd(n, numSub);
    feat[12] = featureSubcarrierMeanRange(n, numSub);
}

#endif  // ENABLE_STAGE_B

// =================================================================
// CALIBRATION ACCUMULATION
// =================================================================

void accumulateCalibration(size_t n, size_t numSub)
{
    // Per-subcarrier temporal variance.
    for (size_t c = 0; c < numSub; ++c) {
        float mean = 0.0f;
        for (size_t t = 0; t < n; ++t) mean += winAmp[t][c];
        mean /= n;
        float var = 0.0f;
        for (size_t t = 0; t < n; ++t) var += (winAmp[t][c] - mean) * (winAmp[t][c] - mean);
        calibVarSum[c] += var / n;
    }

    // MVS of the envelope.
    float env[WINDOW_SIZE];
    for (size_t t = 0; t < n; ++t) {
        float s = 0.0f;
        for (size_t c = 0; c < numSub; ++c) s += winAmp[t][c];
        env[t] = s / numSub;
    }
    calibMvsSum += computeMVS(env, n, MVS_WIN);
    ++calibWindowsCollected;
}

void finaliseCalibration(size_t numSub)
{
    for (size_t c = 0; c < numSub; ++c)
        quietVariances[c] = (float)(calibVarSum[c] / calibWindowsCollected);

    float idleMvs = (float)(calibMvsSum / calibWindowsCollected);
    mvsThreshold  = max(idleMvs * CALIBRATION_FACTOR, MVS_DEFAULT);
    calibrated    = true;

    Serial.printf("{\"event\":\"calibrated\",\"mvs_threshold\":%.6f,\"idle_mvs\":%.6f}\n",
                  mvsThreshold, idleMvs);
}

// =================================================================
// WINDOW PROCESSING
// =================================================================

void processWindow()
{
    size_t n      = WINDOW_SIZE;
    size_t numSub = maxSubcarriers;

    ++windowIndex;

    // ------- Calibration phase -------
    if (!calibrated) {
        accumulateCalibration(n, numSub);
        if (calibWindowsCollected >= CALIBRATION_WINDOWS) {
            finaliseCalibration(numSub);
        } else {
            Serial.printf("{\"event\":\"calibrating\",\"window\":%lu,\"remaining\":%zu}\n",
                          (unsigned long)windowIndex,
                          CALIBRATION_WINDOWS - calibWindowsCollected);
        }
        return;
    }

    // ------- Stage A: Math -------
    float env[WINDOW_SIZE];
    for (size_t t = 0; t < n; ++t) {
        float s = 0.0f;
        for (size_t c = 0; c < numSub; ++c) s += winAmp[t][c];
        env[t] = s / numSub;
    }

    float mvs  = computeMVS(env, n, MVS_WIN);
    float nbvi = computeNBVI(n, numSub, quietVariances, true);

    bool isMotion = (mvs > mvsThreshold) || (nbvi > NBVI_THRESHOLD);

    if (!isMotion) {
        Serial.printf("{\"window\":%lu,\"stage_a\":\"idle\",\"mvs\":%.6f,\"nbvi\":%.4f}\n",
                      (unsigned long)windowIndex, mvs, nbvi);
        return;
    }

    // ------- Stage B: Logistic regression (optional) -------
#if ENABLE_STAGE_B
    float feat[MODEL_B_FEATURE_COUNT];
    extractFeatureVectorB(feat, n, numSub);
    int stageBIdx = model_b_predict(feat);
    const char *stageBLabel = (stageBIdx == 0) ? MODEL_B_LABEL_0 : MODEL_B_LABEL_1;

    Serial.printf(
        "{\"window\":%lu,\"stage_a\":\"motion\",\"stage_b\":\"%s\","
        "\"mvs\":%.6f,\"nbvi\":%.4f}\n",
        (unsigned long)windowIndex, stageBLabel, mvs, nbvi);
#else
    Serial.printf("{\"window\":%lu,\"stage_a\":\"motion\",\"mvs\":%.6f,\"nbvi\":%.4f}\n",
                  (unsigned long)windowIndex, mvs, nbvi);
#endif
}

// =================================================================
// ARDUINO ENTRY POINTS
// =================================================================

void setup()
{
    Serial.begin(921600);
    delay(1000);
    Serial.println();
    Serial.println("ESP Hierarchical Inference starting");
#if ENABLE_STAGE_B
    Serial.println("Stage-A: Math (MVS + NBVI)  |  Stage-B: LogisticRegression");
#else
    Serial.println("Stage-A: Math (MVS + NBVI)  |  Stage-B: disabled");
#endif
    Serial.println("Keep the room EMPTY for calibration windows...");
    Serial.println();

    memset(calibVarSum, 0, sizeof(calibVarSum));

    connectWiFi();
    enableCsi();
}

void loop()
{
    CsiPacket pkt;
    while (popPacket(pkt)) {
        // Determine the canonical subcarrier count for this window.
        if (pkt.subcarrierCount > maxSubcarriers)
            maxSubcarriers = pkt.subcarrierCount;

        // Store amplitude row in the window buffer (edge-pad if shorter).
        if (packetCount < WINDOW_SIZE) {
            size_t sc = pkt.subcarrierCount;
            for (size_t c = 0; c < maxSubcarriers; ++c)
                winAmp[packetCount][c] = (c < sc) ? pkt.amplitudes[c]
                                                   : pkt.amplitudes[sc - 1];
            ++packetCount;
        }

        if (packetCount >= WINDOW_SIZE) {
            processWindow();
            packetCount   = 0;
            maxSubcarriers = 0;
        }
    }
    delay(1);
}
